/*
 * SSD1306 OLED display driver header.
 *
 * @author Michel Megens
 * @email  dev@bietje.net
 */

#include <stdlib.h>
#include <stdio.h>
#include <lwiot.h>

#include <lwiot/kernel/lock.h>
#include <lwiot/log.h>
#include <lwiot/types.h>
#include <lwiot/i2cbus.h>
#include <lwiot/i2cmessage.h>
#include <lwiot/gfxbase.h>
#include <lwiot/device/ssd1306display.h>

/* Commands */
#define SSD1306_SETCONTRAST 0x81
#define SSD1306_DISPLAYALLON_RESUME 0xA4
#define SSD1306_DISPLAYALLON 0xA5
#define SSD1306_NORMALDISPLAY 0xA6
#define SSD1306_INVERTDISPLAY 0xA7
#define SSD1306_DISPLAYOFF 0xAE
#define SSD1306_DISPLAYON 0xAF

#define SSD1306_SETDISPLAYOFFSET 0xD3
#define SSD1306_SETCOMPINS 0xDA

#define SSD1306_SETVCOMDETECT 0xDB

#define SSD1306_SETDISPLAYCLOCKDIV 0xD5
#define SSD1306_SETPRECHARGE 0xD9

#define SSD1306_SETMULTIPLEX 0xA8

#define SSD1306_SETLOWCOLUMN 0x00
#define SSD1306_SETHIGHCOLUMN 0x10

#define SSD1306_SETSTARTLINE 0x40

#define SSD1306_MEMORYMODE 0x20
#define SSD1306_COLUMNADDR 0x21
#define SSD1306_PAGEADDR   0x22

#define SSD1306_COMSCANINC 0xC0
#define SSD1306_COMSCANDEC 0xC8

#define SSD1306_SEGREMAP 0xA0

#define SSD1306_CHARGEPUMP 0x8D

#define SSD1306_EXTERNALVCC 0x1
#define SSD1306_SWITCHCAPVCC 0x2

#define SSD1306_ACTIVATE_SCROLL 0x2F
#define SSD1306_DEACTIVATE_SCROLL 0x2E
#define SSD1306_SET_VERTICAL_SCROLL_AREA 0xA3
#define SSD1306_RIGHT_HORIZONTAL_SCROLL 0x26
#define SSD1306_LEFT_HORIZONTAL_SCROLL 0x27
#define SSD1306_VERTICAL_AND_RIGHT_HORIZONTAL_SCROLL 0x29
#define SSD1306_VERTICAL_AND_LEFT_HORIZONTAL_SCROLL 0x2A

#define ssd1306_swap(a, b) { int16_t t = a; a = b; b = t; }

/* Display buffer */
static uint8_t buffer[SSD1306_LCDHEIGHT * SSD1306_LCDWIDTH / 8] = {
		0x00, 0x00, 0x00, 0x00, 0x00, 0x00, 0x00, 0x00, 0x00, 0x00, 0x00, 0x00, 0x00, 0x00, 0x00, 0x00,
		0x00, 0x00, 0x00, 0x00, 0x00, 0x00, 0x00, 0x00, 0x00, 0x00, 0x00, 0x00, 0x00, 0x00, 0x00, 0x00,
		0x00, 0x00, 0x00, 0x00, 0x00, 0x00, 0x00, 0x00, 0x00, 0x00, 0x00, 0x00, 0x00, 0x00, 0x00, 0x00,
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		0x80, 0x80, 0x00, 0x80, 0x80, 0x00, 0x00, 0x00, 0x00, 0x80, 0x80, 0x80, 0x80, 0x80, 0x00, 0xFF,
#if (SSD1306_LCDHEIGHT * SSD1306_LCDWIDTH > 96 * 16)
		0xFF, 0xFF, 0x00, 0x00, 0x00, 0x00, 0x80, 0x80, 0x80, 0x80, 0x00, 0x00, 0x80, 0x80, 0x00, 0x00,
		0x80, 0xFF, 0xFF, 0x80, 0x80, 0x00, 0x80, 0x80, 0x00, 0x80, 0x80, 0x80, 0x80, 0x00, 0x80, 0x80,
		0x00, 0x00, 0x00, 0x00, 0x00, 0x80, 0x80, 0x00, 0x00, 0x8C, 0x8E, 0x84, 0x00, 0x00, 0x80, 0xF8,
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		0x03, 0x01, 0x00, 0x00, 0x00, 0x00, 0x00, 0x00, 0x00, 0x00, 0x00, 0x00, 0x00, 0x00, 0x00, 0x00,
#if (SSD1306_LCDHEIGHT == 64)
		0x00, 0x00, 0x00, 0x80, 0xC0, 0xE0, 0xF0, 0xF9, 0xFF, 0xFF, 0xFF, 0xFF, 0xFF, 0x3F, 0x1F, 0x0F,
		0x87, 0xC7, 0xF7, 0xFF, 0xFF, 0x1F, 0x1F, 0x3D, 0xFC, 0xF8, 0xF8, 0xF8, 0xF8, 0x7C, 0x7D, 0xFF,
		0xFF, 0xFF, 0xFF, 0xFF, 0xFF, 0xFF, 0xFF, 0x7F, 0x3F, 0x0F, 0x07, 0x00, 0x30, 0x30, 0x00, 0x00,
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		0x00, 0x00, 0x00, 0x00, 0x00, 0x00, 0x00, 0x00, 0x00, 0x00, 0x00, 0x00, 0x00, 0x00, 0x00, 0x00
#endif
#endif
};


namespace lwiot
{
	Ssd1306Display::Ssd1306Display(lwiot::I2CBus &bus, uint8_t addr) : GfxBase(SSD1306_LCDWIDTH, SSD1306_LCDHEIGHT),
	                                                                   _bus(bus), _i2caddr(addr)
	{
	}

	void Ssd1306Display::begin()
	{
		this->writeCommand(SSD1306_DISPLAYOFF);
		this->writeCommand(SSD1306_SETDISPLAYCLOCKDIV);
		this->writeCommand(0x80);

		this->writeCommand(SSD1306_SETMULTIPLEX);
		this->writeCommand(SSD1306_LCDHEIGHT - 1);

		this->writeCommand(SSD1306_SETDISPLAYOFFSET);
		this->writeCommand(0x0);
		this->writeCommand(SSD1306_SETSTARTLINE | 0x0);
		this->writeCommand(SSD1306_CHARGEPUMP);
		this->writeCommand(0x14);
		this->writeCommand(SSD1306_MEMORYMODE);
		this->writeCommand(0x00);
		this->writeCommand(SSD1306_SEGREMAP | 0x1);
		this->writeCommand(SSD1306_COMSCANDEC);

#ifdef SSD1306_128_32
		this->writeCommand(SSD1306_SETCOMPINS);
		this->writeCommand(0x02);
		this->writeCommand(SSD1306_SETCONTRAST);
		this->writeCommand(0x8F);

#elif defined(SSD1306_128_64)
		this->writeCommand(SSD1306_SETCOMPINS);
		this->writeCommand(0x12);
		this->writeCommand(SSD1306_SETCONTRAST);
		this->writeCommand(0xCF);

#elif defined( SSD1306_96_16)
		this->writeCommand(SSD1306_SETCOMPINS);
		this->writeCommand(0x2);
		this->writeCommand(SSD1306_SETCONTRAST);
		this->writeCommand(0xAF);
#endif

		this->writeCommand(SSD1306_SETPRECHARGE);
		this->writeCommand(0xF1);
		this->writeCommand(SSD1306_SETVCOMDETECT);
		this->writeCommand(0x40);
		this->writeCommand(SSD1306_DISPLAYALLON_RESUME);
		this->writeCommand(SSD1306_NORMALDISPLAY);
		this->writeCommand(SSD1306_DEACTIVATE_SCROLL);

		this->writeCommand(SSD1306_DISPLAYON);
	}

	void Ssd1306Display::writeCommand(uint8_t cmd)
	{
		I2CMessage msg(2);

		msg.write(0);
		msg.write(cmd);
		msg.setAddress(Ssd1306Display::SlaveAddress, false, false);

		if(this->_bus.transfer(msg) <= 0) {
			print_dbg("Unable to send SSD1306 command!\n");
			return;
		}
	}

	void Ssd1306Display::drawPixel(int16_t x, int16_t y, uint16_t color)
	{
		if((x < 0) || (x >= width()) || (y < 0) || (y >= height()))
			return;

		switch(getRotation()) {
		case 1: ssd1306_swap(x, y);
			x = WIDTH - x - 1;
			break;

		case 2:
			x = WIDTH - x - 1;
			y = HEIGHT - y - 1;
			break;

		case 3: ssd1306_swap(x, y);
			y = HEIGHT - y - 1;
			break;

		default:
			break;
		}

		switch(color) {
		case WHITE:
			buffer[x + (y / 8) * SSD1306_LCDWIDTH] |= (1 << (y & 7));
			break;

		case BLACK:
			buffer[x + (y / 8) * SSD1306_LCDWIDTH] &= ~(1 << (y & 7));
			break;

		case INVERSE:
			buffer[x + (y / 8) * SSD1306_LCDWIDTH] ^= (1 << (y & 7));
			break;

		default:
			break;
		}
	}

	void Ssd1306Display::invert(bool invert)
	{
		if(invert)
			this->writeCommand(SSD1306_INVERTDISPLAY);
		else
			this->writeCommand(SSD1306_NORMALDISPLAY);
	}

	void Ssd1306Display::clear(void)
	{
		memset(buffer, 0, (SSD1306_LCDWIDTH * SSD1306_LCDHEIGHT / 8));
	}

	void Ssd1306Display::dim(bool dim)
	{
		uint8_t contrast;

		if(dim)
			contrast = 0;
		else
			contrast = 0xCF;

		this->writeCommand(SSD1306_SETCONTRAST);
		this->writeCommand(contrast);
	}

	void Ssd1306Display::display(void)
	{
		this->writeCommand(SSD1306_COLUMNADDR);
		this->writeCommand(0);
		this->writeCommand(SSD1306_LCDWIDTH - 1);

		this->writeCommand(SSD1306_PAGEADDR);
		this->writeCommand(0);
#if SSD1306_LCDHEIGHT == 64
		this->writeCommand(7);
#endif
#if SSD1306_LCDHEIGHT == 32
		this->writeCommand(3); // Page end address
#endif
#if SSD1306_LCDHEIGHT == 16
		this->writeCommand(1); // Page end address
#endif


		for(uint16_t i = 0; i < (SSD1306_LCDWIDTH * SSD1306_LCDHEIGHT / 8); i++) {
			I2CMessage msg(17);

			msg.setAddress(this->_i2caddr, false, false);
			msg.setRepeatedStart(false);
			msg.write(0x40);

			for(uint8_t x = 0; x < 16; x++) {
				msg.write(buffer[i]);
				i++;
			}
			i--;

			this->_bus.transfer(msg);
		}
	}

	void Ssd1306Display::rawDrawHorizontalLine(int16_t x, int16_t y, int16_t w, uint16_t color)
	{
		uint8_t *pBuf, mask;

		if(y < 0 || y >= HEIGHT) {
			return;
		}

		if(x < 0) {
			w += x;
			x = 0;
		}

		if((x + w) > WIDTH) {
			w = (WIDTH - x);
		}

		if(w <= 0) {
			return;
		}

		pBuf = buffer;
		pBuf += ((y / 8) * SSD1306_LCDWIDTH);
		pBuf += x;
		mask = 1 << (y & 7);

		switch(color) {
		case WHITE:
			while(w--) {
				*pBuf++ |= mask;
			};
			break;
		case BLACK:
			mask = ~mask;
			while(w--) {
				*pBuf++ &= mask;
			};
			break;
		case INVERSE:
			while(w--) {
				*pBuf++ ^= mask;
			};
			break;

		default:
			break;
		}
	}

	void Ssd1306Display::drawFastVLine(int16_t x, int16_t y, int16_t h, uint16_t color)
	{
		bool bSwap = false;

		switch(rotation) {
		case 0:
		default:
			break;

		case 1:
			bSwap = true;
			ssd1306_swap(x, y);
			x = WIDTH - x - 1;
			x -= (h - 1);
			break;

		case 2:
			x = WIDTH - x - 1;
			y = HEIGHT - y - 1;
			y -= (h - 1);
			break;

		case 3:
			bSwap = true;
			ssd1306_swap(x, y);
			y = HEIGHT - y - 1;
			break;
		}

		if(bSwap) {
			this->rawDrawHorizontalLine(x, y, h, color);
		} else {
			this->rawDrawVerticalLine(x, y, h, color);
		}
	}


	void Ssd1306Display::rawDrawVerticalLine(int16_t x, int16_t __y, int16_t __h, uint16_t color)
	{
		static uint8_t premask[8] = {0x00, 0x80, 0xC0, 0xE0, 0xF0, 0xF8, 0xFC, 0xFE};
		uint8_t *pBuf, mod;
		uint8_t y, h;

		if(x < 0 || x >= WIDTH) {
			return;
		}

		if(__y < 0) {
			__h += __y;
			__y = 0;
		}

		if((__y + __h) > HEIGHT) {
			__h = (HEIGHT - __y);
		}

		if(__h <= 0) {
			return;
		}

		y = __y;
		h = __h;

		pBuf = buffer;
		pBuf += ((y / 8) * SSD1306_LCDWIDTH);
		pBuf += x;
		mod = (y & 7);

		if(mod) {
			mod = 8 - mod;
			uint8_t mask = premask[mod];

			if(h < mod) {
				mask &= (0XFF >> (mod - h));
			}

			switch(color) {
			case WHITE:
				*pBuf |= mask;
				break;

			case BLACK:
				*pBuf &= ~mask;
				break;

			case INVERSE:
				*pBuf ^= mask;
				break;

			default:
				break;
			}

			if(h < mod) {
				return;
			}

			h -= mod;

			pBuf += SSD1306_LCDWIDTH;
		}


		if(h >= 8) {
			if(color ==
			   INVERSE) {
				do {
					*pBuf = ~(*pBuf);
					pBuf += SSD1306_LCDWIDTH;
					h -= 8;
				} while(h >= 8);
			} else {
				uint8_t val = (color == WHITE) ? 255 : 0;
				do {
					*pBuf = val;
					pBuf += SSD1306_LCDWIDTH;
					h -= 8;
				} while(h >= 8);
			}
		}

		if(h) {
			mod = h & 7;
			static uint8_t postmask[8] = {0x00, 0x01, 0x03, 0x07, 0x0F, 0x1F, 0x3F, 0x7F};
			uint8_t mask = postmask[mod];

			switch(color) {
			case WHITE:
				*pBuf |= mask;
				break;
			case BLACK:
				*pBuf &= ~mask;
				break;
			case INVERSE:
				*pBuf ^= mask;
				break;

			default:
				break;
			}
		}
	}

	void Ssd1306Display::drawFastHLine(int16_t x, int16_t y, int16_t w, uint16_t color)
	{
		bool bSwap = false;

		switch(rotation) {
		default:
		case 0:
			break;
		case 1:
			bSwap = true;
			ssd1306_swap(x, y);
			x = WIDTH - x - 1;
			break;
		case 2:
			x = WIDTH - x - 1;
			y = HEIGHT - y - 1;
			x -= (w - 1);
			break;
		case 3:
			bSwap = true;
			ssd1306_swap(x, y);
			y = HEIGHT - y - 1;
			y -= (w - 1);
			break;
		}

		if(bSwap) {
			this->rawDrawVerticalLine(x, y, w, color);
		} else {
			this->rawDrawHorizontalLine(x, y, w, color);
		}
	}

	void Ssd1306Display::startScrollRight(uint8_t start, uint8_t stop)
	{
		this->writeCommand(SSD1306_RIGHT_HORIZONTAL_SCROLL);
		this->writeCommand(0X00);
		this->writeCommand(start);
		this->writeCommand(0X00);
		this->writeCommand(stop);
		this->writeCommand(0X00);
		this->writeCommand(0XFF);
		this->writeCommand(SSD1306_ACTIVATE_SCROLL);
	}

	void Ssd1306Display::startScrollLeft(uint8_t start, uint8_t stop)
	{
		this->writeCommand(SSD1306_LEFT_HORIZONTAL_SCROLL);
		this->writeCommand(0X00);
		this->writeCommand(start);
		this->writeCommand(0X00);
		this->writeCommand(stop);
		this->writeCommand(0X00);
		this->writeCommand(0XFF);
		this->writeCommand(SSD1306_ACTIVATE_SCROLL);
	}

	void Ssd1306Display::startScrollDiagonalLeft(uint8_t start, uint8_t stop)
	{
		this->writeCommand(SSD1306_SET_VERTICAL_SCROLL_AREA);
		this->writeCommand(0X00);
		this->writeCommand(SSD1306_LCDHEIGHT);
		this->writeCommand(SSD1306_VERTICAL_AND_LEFT_HORIZONTAL_SCROLL);
		this->writeCommand(0X00);
		this->writeCommand(start);
		this->writeCommand(0X00);
		this->writeCommand(stop);
		this->writeCommand(0X01);
		this->writeCommand(SSD1306_ACTIVATE_SCROLL);
	}

	void Ssd1306Display::startScrollDiagonalRight(uint8_t start, uint8_t stop)
	{
		this->writeCommand(SSD1306_SET_VERTICAL_SCROLL_AREA);
		this->writeCommand(0X00);
		this->writeCommand(SSD1306_LCDHEIGHT);
		this->writeCommand(SSD1306_VERTICAL_AND_RIGHT_HORIZONTAL_SCROLL);
		this->writeCommand(0X00);
		this->writeCommand(start);
		this->writeCommand(0X00);
		this->writeCommand(stop);
		this->writeCommand(0X01);
		this->writeCommand(SSD1306_ACTIVATE_SCROLL);
	}

	void Ssd1306Display::stopScroll()
	{
		this->writeCommand(SSD1306_DEACTIVATE_SCROLL);
	}
}
